//Clog Detector by Elite Worm (YouTube.com/c/EliteWorm)
//Version 1.0.0

#include <TinyWireM.h>
#include <TinyOzOLED.h>

const unsigned char clogged_bmp [] PROGMEM = {
	0x00, 0x00, 0x00, 0x00, 0x00, 0x00, 0x00, 0x00, 0x00, 0x00, 0x00, 0x00, 0x00, 0x00, 0x00, 0x00, 
	0x00, 0x00, 0x00, 0x00, 0x00, 0x00, 0x00, 0x00, 0x00, 0x00, 0x00, 0x00, 0x00, 0x00, 0x00, 0x00, 
	0x00, 0x00, 0x00, 0x00, 0x00, 0x00, 0x00, 0x00, 0x00, 0x00, 0x00, 0x00, 0x00, 0x00, 0x00, 0x00, 
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	0x00, 0x00, 0x00, 0x00, 0x00, 0x00, 0x00, 0x00, 0x00, 0x00, 0x00, 0x00, 0x00, 0x00, 0x00, 0x00
};

const unsigned char off_bmp [] PROGMEM = {
	0x00, 0x00, 0x00, 0x00, 0x00, 0x00, 0x00, 0x00, 0x00, 0x00, 0x00, 0x00, 0x00, 0x00, 0x00, 0x00, 
	0x00, 0x00, 0x00, 0x00, 0x00, 0x00, 0x00, 0x00, 0x00, 0x00, 0x00, 0x00, 0x00, 0x00, 0x00, 0x00, 
	0x00, 0x00, 0x00, 0x00, 0x00, 0x00, 0x00, 0x00, 0x00, 0x00, 0x00, 0x00, 0x00, 0x00, 0x00, 0x00, 
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	0x00, 0x00, 0x00, 0x00, 0x00, 0x00, 0x00, 0x00, 0x00, 0x00, 0x00, 0x00, 0x00, 0x00, 0x00, 0x00
};

const unsigned char on_bmp [] PROGMEM = {
	0x00, 0x00, 0x00, 0x00, 0x00, 0x00, 0x00, 0x00, 0x00, 0x00, 0x00, 0x00, 0x00, 0x00, 0x00, 0x00, 
	0x00, 0x00, 0x00, 0x00, 0x00, 0x00, 0x00, 0x00, 0x00, 0x00, 0x00, 0x00, 0x00, 0x00, 0x00, 0x00, 
	0x00, 0x00, 0x00, 0x00, 0x00, 0x00, 0x00, 0x00, 0x00, 0x00, 0x00, 0x00, 0x00, 0x00, 0x00, 0x00, 
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	0x00, 0x00, 0x00, 0x00, 0x00, 0x00, 0x00, 0x00, 0x00, 0x00, 0x00, 0x00, 0x00, 0x00, 0x00, 0x00
};

bool printstarted = false;
bool clog = false;
byte program_step = 0;
unsigned long previousmillis = 0;
bool currentLDRstate = 0;
bool previousLDRstate = 0;

void setup() {
  
  pinMode(3, OUTPUT); //BUZZER
  pinMode(1, INPUT); //LDR
  pinMode(4, INPUT); //PUSH BUTTON 
  
  digitalWrite(3, LOW);
  
  OzOled.init();
  OzOled.clearDisplay();
  OzOled.setNormalDisplay();
  OzOled.setBrightness(255);  
  OzOled.sendCommand(0xA8);
  OzOled.sendCommand(0x1F);
  OzOled.sendCommand(0xDA);
  OzOled.sendCommand(0x02);  
  OzOled.printString(" ELITE WORM",2,0);
  OzOled.printString("   V1.0.0",2,3);
  delay(3000);
  OzOled.drawBitmap(off_bmp,0,0,16,4);
  
}

void loop() {
  
  currentLDRstate = digitalRead(1);
  
  if((digitalRead(4) == LOW) && (!printstarted)) {
    
    printstarted = true;
    previousLDRstate = currentLDRstate;
    program_step = 1;
    
  }
  
  if(printstarted) printing();
  
  if(clog) clogged();
  
}

void printing() {
    
  switch(program_step) {
  
      case 0:
        
        OzOled.clearDisplay();
        OzOled.drawBitmap(off_bmp,0,0,16,4);
        printstarted = false;
        delay(300);
      
      break;
    
      case 1:
        
        OzOled.clearDisplay();
        OzOled.drawBitmap(on_bmp,0,0,16,4);
        previousmillis = millis();
        program_step++;
        delay(300);
        
      break;
      
      case 2:
      
        if((millis() - previousmillis) >= 420000) program_step = 3;
        
        if(currentLDRstate != previousLDRstate) {
          
          previousmillis = millis();
          previousLDRstate = currentLDRstate;
          OzOled.clearDisplay();
          OzOled.drawBitmap(on_bmp,0,0,16,4);
          
        }
          
        if(digitalRead(4) == LOW) program_step = 0;
      
      break;
      
      case 3:
      
        clog = true;
        OzOled.clearDisplay();
        OzOled.drawBitmap(clogged_bmp,0,0,16,4);
        program_step++;
        
      break;
      
      case 4:
      
        if(digitalRead(4) == LOW) {
          
          program_step = 0;
          clog = false;
          digitalWrite(3, LOW);
      
        }      
      
      break;
  
  }
  
}

void clogged() {
  
  if((millis() - previousmillis) >= 500) {
  
    digitalWrite((3), !digitalRead(3));
    previousmillis = millis();
    
  }  
  
}
